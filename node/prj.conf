## CMakeLists.txt
```
cmake_minimum_required(VERSION 3.20.0)

find_package(Zephyr REQUIRED HINTS $ENV{ZEPHYR_BASE})
project(NONE)

# NORDIC SDK APP START
# Agrega todos los .c dentro de src/
file(GLOB app_sources src/*.c ../shared/*.c)

# Agrega los archivos al target
target_sources(app PRIVATE ${app_sources})

target_include_directories(app PRIVATE include ../shared)

# NORDIC SDK APP END
zephyr_library_include_directories(.)
```

## prj.conf
```kconfig
#
# License MIT 2025 Agustín Coitinho
#

# Logger module
CONFIG_LOG=y

# Button and LED library
CONFIG_DK_LIBRARY=y

# Bluetooth LE support
CONFIG_BT=y

# Bluetooth Peripheral support
CONFIG_BT_PERIPHERAL=y

# Bluetooth Central support
CONFIG_BT_CENTRAL=y
CONFIG_BT_GATT_CLIENT=y

CONFIG_BT_SCAN=y
CONFIG_BT_SCAN_FILTER_ENABLE=y
CONFIG_BT_SCAN_ADDRESS_CNT=4
CONFIG_BT_SCAN_NAME_CNT=4

CONFIG_BT_SCAN_WITH_IDENTITY=y

# Change the Bluetooth device name
CONFIG_BT_DEVICE_NAME="Jelly BLE Node"

CONFIG_MAIN_STACK_SIZE=2048
CONFIG_SYSTEM_WORKQUEUE_STACK_SIZE=2048
CONFIG_HEAP_MEM_POOL_SIZE=8192

CONFIG_BT_MAX_CONN=2
CONFIG_BT_MAX_PAIRED=2

CONFIG_TFM_PROFILE_TYPE_NOT_SET=y
```

## src/main.c
```c
/*
 * MIT License 2025
 * Author: Agustín Coitinho
 * Jelly BLE is a project developed within the course
 * "Tecnologías para la Internet de las Cosas"
 * Facultad de Ingeniería - Universidad de la República, Uruguay
 */
#include <zephyr/kernel.h>
#include <zephyr/bluetooth/bluetooth.h>
#include <zephyr/logging/log.h>
#include <zephyr/bluetooth/conn.h>
#include <zephyr/bluetooth/gatt.h>
#include "ble_common.h"
#include "scanning.h"
#include "led.h"
#include "ble_callbacks.h"
#include "jelly_rtt_service.h"
#include "button.h"
#include "connection_manager.h"
#include "rtt_manager.h"
#include "power_debug.h"

LOG_MODULE_REGISTER(node_main, LOG_LEVEL_INF);

/* Write app callback */
static void node_rx_cb(struct bt_conn *conn, const jrs_pkt_t *pkt)
{
    /* MEASUREMENT: Forward message upward (received from child) */
    power_debug_start(DBG_FORWARD);

    struct bt_conn *parent_conn = get_parent_conn();
    if (parent_conn) {
        // Intermediate node: Increment and forward upward
        jrs_pkt_t new_pkt = { .counter = pkt->counter + 1 };
        int err = bt_gatt_write_without_response(parent_conn, get_jrs_value_handle(), &new_pkt, sizeof(new_pkt), false);
        if (err) {
            LOG_ERR("Failed to forward upward (err %d)", err);
        } else {
            LOG_INF("Forwarded upward: counter=%d", new_pkt.counter);
        }
    }

    power_debug_end(DBG_FORWARD);
}

/* Button handler: called by the node that starts packet transfer */
static void button_handler(uint32_t button_state, uint32_t has_changed)
{
    if (has_changed & USER_BUTTON && !(button_state & USER_BUTTON)) {
        /* MEASUREMENT: Send a message (initiated by button) */
        power_debug_start(DBG_MESSAGE_TX);

        // Store timestamp
        if (rtt_store_timestamp()) {
            LOG_ERR("Failed to store timestamp");
            power_debug_end(DBG_MESSAGE_TX);
            return;
        }

        // Sends counter=0
        jrs_pkt_t pkt = { .counter = 0 };
        struct bt_conn *parent_conn = get_parent_conn();
        if (parent_conn) {
            int err = bt_gatt_write_without_response(parent_conn, get_jrs_value_handle(), &pkt, sizeof(pkt), false);
            if (err) {
                LOG_ERR("Failed to send upward (err %d)", err);
            } else {
                LOG_INF("Sent upward from button: counter=%d", pkt.counter);
            }
        }

        power_debug_end(DBG_MESSAGE_TX);
    }
}

int main(void)
{
    LOG_INF("Starting Jelly BLE Node");

    if (led_init()) {
        LOG_ERR("Failed to initiate the LED module.");
        return -1;
    }

    /* Initialize debug module for current measurements */
    if (power_debug_init()) {
        LOG_ERR("Failed to initiate Power Debug module.");
        return -1;
    }

    register_peripheral_connection_callbacks();

    rtt_manager_init();

    ble_init();
    bt_jrs_init(node_rx_cb);

    register_central_connection_callbacks();
    LOG_INF("Starting node scanning...");
    /* MEASUREMENT: Start scanning - P1.00 is activated in start_scanning() */
    start_scanning();

    LOG_INF("Starting advertising...");
    ble_advertising_init();
    /* MEASUREMENT: Start advertising - P1.02 HIGH when advertising starts */
    power_debug_start(DBG_ADVERTISING);
    ble_advertising_start();

    if (init_button(button_handler)) {
        LOG_ERR("Failed to initiate the button module.");
        return -1;
    }

    //led_blink_loop(1000);

    return 0;
}
```

## include/ble_callbacks.h
```c
/*
 * MIT License 2025
 * Author: Agustín Coitinho
 * Jelly BLE is a project developed within the course
 * "Tecnologías para la Internet de las Cosas"
 * Facultad de Ingeniería - Universidad de la República, Uruguay
 */
#pragma once

#define CONNECTED_LED RUN_STATUS_LED

void register_peripheral_connection_callbacks(void);
```

## include/connection_manager.h
```c
/*
 * MIT License 2025
 * Author: Agustín Coitinho
 * Jelly BLE is a project developed within the course
 * "Tecnologías para la Internet de las Cosas"
 * Facultad de Ingeniería - Universidad de la República, Uruguay
 */
#pragma once

#include <zephyr/bluetooth/bluetooth.h>

/* Get parent connection */
struct bt_conn *get_parent_conn(void);

/* Get child connection */
struct bt_conn *get_child_conn(void);

/* Set parent connection */
void set_parent_conn(struct bt_conn *conn);

/* Set child connection */
void set_child_conn(struct bt_conn *conn);
```

## include/scanning.h
```c
/*
 * MIT License 2025
 * Author: Agustín Coitinho
 * Jelly BLE is a project developed within the course
 * "Tecnologías para la Internet de las Cosas"
 * Facultad de Ingeniería - Universidad de la República, Uruguay
 */
#pragma once
#include <zephyr/bluetooth/conn.h>
#include <zephyr/bluetooth/bluetooth.h>

#define COORDINATOR_RETRY_TIMES 15

void register_central_connection_callbacks(void);

/* Initialize and start scanning for the coordinator */
int start_scanning(void);

/* Connect to the detected device */
void connect_to_device(const bt_addr_le_t *addr, const struct bt_le_conn_param *conn_param);
```

## src/ble_callbacks.c
```c
/*
 * MIT License 2025
 * Author: Agustín Coitinho
 * Jelly BLE is a project developed within the course
 * "Tecnologías para la Internet de las Cosas"
 * Facultad de Ingeniería - Universidad de la República, Uruguay
 */
#include <zephyr/bluetooth/conn.h>
#include <zephyr/logging/log.h>
#include <dk_buttons_and_leds.h>
#include <zephyr/bluetooth/gatt.h>
#include "led.h"
#include "ble_common.h"
#include "scanning.h"
#include "connection_manager.h"
#include "ble_callbacks.h"
#include "jelly_rtt_service.h"
#include "rtt_manager.h"
#include "power_debug.h"

static struct bt_uuid_128 discover_uuid = BT_UUID_INIT_128(0);
static struct bt_gatt_discover_params discover_params;
struct bt_gatt_subscribe_params subscribe_params;

LOG_MODULE_REGISTER(ble_callbacks, LOG_LEVEL_INF);


/* Notify handler (downward) */
static uint8_t notify_func(struct bt_conn *conn,
			   struct bt_gatt_subscribe_params *params,
			   const void *data, uint16_t length)
{
	if (length != sizeof(jrs_pkt_t)) {
        return BT_GATT_ITER_STOP;
    }

    /* MEASUREMENT: Receive message from parent */
    power_debug_pulse(1);  /* Short pulse on P1.01 for RX */

    jrs_pkt_t pkt;
    memcpy(&pkt, data, length);
    LOG_INF("Notify received: counter=%d", pkt.counter);

    if (pkt.counter == 0) {
        // This node has started the communication, compute RTT
        rtt_compute_time();
    } else {
        /* MEASUREMENT: Forward message downward (to child) */
        power_debug_start(DBG_FORWARD);

        // Forward downward
        pkt.counter--;
        struct bt_conn *child_conn = get_child_conn();
        if (child_conn) {
            int err = jrs_notify(child_conn, &pkt);
            if (err) {
                LOG_ERR("Failed to notify downward (err %d)", err);
            } else {
                LOG_INF("Forwarded downward: counter=%d", pkt.counter);
            }
        }

        power_debug_end(DBG_FORWARD);
    }

    return BT_GATT_ITER_CONTINUE;
}

static uint8_t discover_func(struct bt_conn *conn,
			     const struct bt_gatt_attr *attr,
			     struct bt_gatt_discover_params *params)
{
	int err;

	if (!attr) {
		LOG_INF("Discover complete");
		(void)memset(params, 0, sizeof(*params));
		return BT_GATT_ITER_STOP;
	}

	LOG_INF("[ATTRIBUTE] handle %u", attr->handle);

	if (!bt_uuid_cmp(discover_params.uuid, BT_UUID_JRS)) {
        LOG_INF("Found JRS service");
        set_jrs_service_handle(attr->handle);
		memcpy(&discover_uuid, BT_UUID_JRS_PKT, sizeof(discover_uuid));

		discover_params.uuid = &discover_uuid.uuid;
		discover_params.start_handle = attr->handle + 1;
		discover_params.type = BT_GATT_DISCOVER_CHARACTERISTIC;

		err = bt_gatt_discover(conn, &discover_params);
		if (err) {
			LOG_INF("Discover failed (err %d)", err);
		}
	} else if (!bt_uuid_cmp(discover_params.uuid,
				BT_UUID_JRS_PKT)) {
        struct bt_gatt_chrc *chrc = (struct bt_gatt_chrc *)attr->user_data;
        set_jrs_char_decl_handle(attr->handle);
        set_jrs_value_handle(chrc->value_handle);
		discover_params.uuid = BT_UUID_GATT_CCC;
		discover_params.start_handle = attr->handle + 2;
		discover_params.type = BT_GATT_DISCOVER_DESCRIPTOR;

		subscribe_params.value_handle = bt_gatt_attr_value_handle(attr);

		err = bt_gatt_discover(conn, &discover_params);
		if (err) {
			LOG_INF("Discover failed (err %d)", err);
		}
	} else {
        /* CCC found, now subscribe */
        set_jrs_ccc_handle(attr->handle);
		subscribe_params.notify = notify_func;
		subscribe_params.value = BT_GATT_CCC_NOTIFY;
		subscribe_params.ccc_handle = attr->handle;

		err = bt_gatt_subscribe(conn, &subscribe_params);
		if (err && err != -EALREADY) {
			LOG_INF("Subscribe failed (err %d)", err);
		} else {
			LOG_INF("[SUBSCRIBED]");
		}

		return BT_GATT_ITER_STOP;
	}

	return BT_GATT_ITER_STOP;
}

static void on_connected(struct bt_conn *conn, uint8_t err) {
    if (err) { // revisar
		LOG_ERR("Connection error %d", err);
        if (conn == get_parent_conn()) {
            set_parent_conn(NULL);
        } else if (conn == get_child_conn()) {
            set_child_conn(NULL);
        }
		return;
	}
    if (conn != get_parent_conn()) {
        /* MEASUREMENT: Connecting to child - End of connection process */
        power_debug_pulse(0);  /* Pulse on P1.00 to mark child connection event */

        set_child_conn(conn);
        dk_set_led(CONNECTED_LED, 1);

        /* MEASUREMENT: Idle without advertising - P1.02 LOW when child connected */
        power_debug_clear(2);

    } else {
        /* MEASUREMENT: Connected to parent - End of connection process */
        power_debug_end(DBG_CONNECTING);
        power_debug_set(1);  /* P1.01 HIGH = connected to parent */

        // parent
        memcpy(&discover_uuid, BT_UUID_JRS, sizeof(discover_uuid));
		discover_params.uuid = &discover_uuid.uuid;
		discover_params.func = discover_func;
		discover_params.start_handle = BT_ATT_FIRST_ATTRIBUTE_HANDLE;
		discover_params.end_handle = BT_ATT_LAST_ATTRIBUTE_HANDLE;
		discover_params.type = BT_GATT_DISCOVER_PRIMARY;

		err = bt_gatt_discover(get_parent_conn(), &discover_params);
		if (err) {
			LOG_INF("Discover failed(err %d)", err);
			return;
		}
    }
}

static void on_disconnected(struct bt_conn *conn, uint8_t reason) {
    int err;
    LOG_INF("Disconnected. Reason %d", reason);
    if (conn == get_parent_conn()) {
        LOG_INF("Parent disconnected");
        set_parent_conn(NULL);

        /* MEASUREMENT: Disconnected from parent, return to scanning */
        power_debug_clear(1);  /* P1.01 LOW = not connected */

        /* Restart scanning */
        err = start_scanning();
        if (err) {
            LOG_ERR("Failed to restart scanning (err %d)", err);
        }
    } else if (conn == get_child_conn()) {
        set_child_conn(NULL);
        dk_set_led(CONNECTED_LED, 0);
        LOG_INF("Child disconnected");

        /* MEASUREMENT: Disconnected from child, return to advertising */
        power_debug_set(2);  /* P1.02 HIGH = advertising active */

        /* Restart advertising */
        ble_advertising_start();
    } else {
        LOG_ERR("Disconnected unknown connection");
    }
}

/* static void on_le_param_updated(struct bt_conn *conn, uint16_t interval,
                                uint16_t latency, uint16_t timeout) {
    double connection_interval = interval*1.25; // in ms
	uint16_t supervision_timeout = timeout*10; // in ms
	LOG_INF("Connection parameters updated: interval %.2f ms, latency %d intervals, timeout %d ms", connection_interval, latency, supervision_timeout);
}*/

void on_recycled(void)
{
	//ble_advertising_start();
}

void register_peripheral_connection_callbacks(void)
{
    static struct bt_conn_cb connection_callbacks = {
        .connected = on_connected,
        .disconnected = on_disconnected,
        .recycled = on_recycled,
    };

    int err = bt_conn_cb_register(&connection_callbacks);
    if (err) {
        LOG_ERR("Connection callback register failed (err %d)", err);
    }
}
```

## src/connection_manager.c
```c
/*
 * MIT License 2025
 * Author: Agustín Coitinho
 * Jelly BLE is a project developed within the course
 * "Tecnologías para la Internet de las Cosas"
 * Facultad de Ingeniería - Universidad de la República, Uruguay
 */
#include <zephyr/bluetooth/conn.h>
#include <zephyr/logging/log.h>
#include <zephyr/bluetooth/bluetooth.h>
#include "connection_manager.h"

LOG_MODULE_REGISTER(connection_manager, LOG_LEVEL_INF);

static struct bt_conn *parent_conn = NULL;
static struct bt_conn *child_conn = NULL;

/* Get parent connection */
struct bt_conn *get_parent_conn(void)
{
    return parent_conn;
}

/* Get child connection */
struct bt_conn *get_child_conn(void)
{
    return child_conn;
}

/* Set parent connection */
void set_parent_conn(struct bt_conn *conn)
{
    if (conn == parent_conn) {
        LOG_DBG("set_parent_conn: same pointer, no change (%p)", (void *)conn);
        return;
    }

    if (parent_conn) {
        bt_conn_unref(parent_conn);
        parent_conn = NULL;
    }

    parent_conn = conn ? bt_conn_ref(conn) : NULL;

    LOG_INF("Parent connection set to %p", (void *)parent_conn);
}

/* Set child connection */
void set_child_conn(struct bt_conn *conn)
{
    if (conn == child_conn) {
        LOG_DBG("set_child_conn: same pointer, no change (%p)", (void *)conn);
        return;
    }

    if (child_conn) {
        bt_conn_unref(child_conn);
        child_conn = NULL;
    }

    child_conn = conn ? bt_conn_ref(conn) : NULL;

    LOG_INF("Child connection set to %p", (void *)child_conn);
}
```

## src/scanning.c
```c
/*
 * MIT License 2025
 * Author: Agustín Coitinho
 * Jelly BLE is a project developed within the course
 * "Tecnologías para la Internet de las Cosas"
 * Facultad de Ingeniería - Universidad de la República, Uruguay
 */
#include <zephyr/bluetooth/bluetooth.h>
#include <zephyr/bluetooth/gatt.h>
#include <zephyr/logging/log.h>
#include <bluetooth/scan.h>
#include "scanning.h"
#include "connection_manager.h"
#include "jelly_rtt_service.h"
#include "rtt_manager.h"
#include "power_debug.h"

LOG_MODULE_REGISTER(scanning, LOG_LEVEL_INF);

static uint8_t matchs_nb = 0;

/* Callback for filter match */
static void scan_filter_match(struct bt_scan_device_info *device_info,
                            struct bt_scan_filter_match *filter_match,
                            bool connectable)
{
    if (filter_match->name.match) {
        char addr_str[BT_ADDR_LE_STR_LEN];
        bt_addr_le_to_str(device_info->recv_info->addr, addr_str, sizeof(addr_str));

        /* Connection is established automatically if connect_if_match is enabled */
        if (strcmp(filter_match->name.name, "Jelly BLE Coordinator") == 0) {
            matchs_nb = 0;
            LOG_INF("Coordinator found: %s (name: %s)", addr_str, filter_match->name.name);
            connect_to_device(device_info->recv_info->addr, device_info->conn_param); 
        } else if (strcmp(filter_match->name.name, "Jelly BLE Node") == 0) {
            matchs_nb++;
            LOG_INF("Node found: %s (name: %s)", addr_str, filter_match->name.name);
            if (matchs_nb == COORDINATOR_RETRY_TIMES) {
                // IMPROVEMENT: choose the shortest+ path to the coordinator
                matchs_nb = 0;
                connect_to_device(device_info->recv_info->addr, device_info->conn_param);
            }
        } else {
            LOG_WRN("Unknown device found: %s (name: %s)", addr_str, filter_match->name.name);
            return;
        }
    }
}

/* Callback for filter no-match */
static void scan_filter_no_match(struct bt_scan_device_info *device_info,
                                bool connectable)
{

}

/* Callback for connection errors */
static void scan_connecting_error(struct bt_scan_device_info *device_info)
{
    LOG_ERR("Connection failed");
    /* MEASUREMENT: Connection failed, return to scanning */
    power_debug_end(DBG_CONNECTING);
    power_debug_start(DBG_SCANNING);
    /* Restart scanning */
    bt_scan_start(BT_SCAN_TYPE_SCAN_PASSIVE);
}

/* Callback for ongoing connection, only for connect_if_match == true */
static void scan_connecting(struct bt_scan_device_info *device_info, struct bt_conn *conn)
{
    set_parent_conn(conn); 
}

/* Scanning callback structure */
BT_SCAN_CB_INIT(scan_cb, scan_filter_match, scan_filter_no_match, 
    scan_connecting_error, scan_connecting);

void register_central_connection_callbacks(void)
{
    bt_scan_cb_register(&scan_cb); // it must be called only once!
}

/* Initialize and start scanning for the parent */
int start_scanning(void)
{
    int err;

    /* Initialize scanning module */
    struct bt_scan_init_param scan_init = {
        .scan_param = NULL, /* Use default parameters */
        .connect_if_match = false, /* Do not connect automatically on filter match */
        .conn_param = BT_LE_CONN_PARAM_DEFAULT,
    };
    bt_scan_init(&scan_init);

    bt_scan_filter_remove_all();

    /* Add filter for parent name */
    err = bt_scan_filter_add(BT_SCAN_FILTER_TYPE_NAME, "Jelly BLE Coordinator");
    if (err) {
        LOG_ERR("Failed to add name filter (err %d)", err);
        return err;
    }

    /* Add filter for node name */
    err = bt_scan_filter_add(BT_SCAN_FILTER_TYPE_NAME, "Jelly BLE Node");
    if (err) {
        LOG_ERR("Failed to add name filter (err %d)", err);
        return err;
    }

    /* Enable name filter */
    err = bt_scan_filter_enable(BT_SCAN_NAME_FILTER, false);
    if (err) {
        LOG_ERR("Failed to enable filter (err %d)", err);
        return err;
    }

    /* MEASUREMENT: Scanning - P1.00 HIGH during scanning */
    power_debug_start(DBG_SCANNING);

    /* Start scanning */
    err = bt_scan_start(BT_SCAN_TYPE_SCAN_PASSIVE);
    if (err) {
        LOG_ERR("Failed to start scanning (err %d)", err);
        power_debug_end(DBG_SCANNING);
        return err;
    }

    LOG_INF("Coordinator scanning started");
    return 0;
}

void connect_to_device(const bt_addr_le_t *addr, const struct bt_le_conn_param *conn_param)
{
    int err;
    struct bt_conn *conn = NULL;

    /* MEASUREMENT: Connecting to parent - Transition from scanning to connecting */
    power_debug_end(DBG_SCANNING);  /* End of scanning */
    power_debug_start(DBG_CONNECTING);  /* Start of connecting */

    bt_scan_stop();
    err = bt_conn_le_create(addr, BT_CONN_LE_CREATE_CONN, conn_param, &conn);
    if (err) {
        LOG_ERR("Failed to create connection (err %d)", err);
        power_debug_end(DBG_CONNECTING);
        /* Restart scanning on failure */
        power_debug_start(DBG_SCANNING);
        bt_scan_start(BT_SCAN_TYPE_SCAN_ACTIVE);
    } else {
        LOG_INF("Connection initiated");
        /* Update parent connection */
        set_parent_conn(conn);
        bt_conn_unref(conn);
        /* CONNECTING state ends in on_connected callback */
    }
}
```
