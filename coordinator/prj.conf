## prj.conf
```kconfig
#
# License MIT 2025 
#
# Author: Agustín Coitinho
#

# Logger module
CONFIG_LOG=y

# Button and LED library
CONFIG_DK_LIBRARY=y

# Floating Point Unit
CONFIG_FPU=y

# Bluetooth LE support
CONFIG_BT=y

# Bluetooth Peripheral support
CONFIG_BT_PERIPHERAL=y
CONFIG_BT_CENTRAL=n
CONFIG_TFM_PROFILE_TYPE_NOT_SET=y 

# Change the Bluetooth device name
CONFIG_BT_DEVICE_NAME="Jelly BLE Coordinator"

CONFIG_BT_LBS=y
CONFIG_BT_LBS_POLL_BUTTON=y
CONFIG_BT_GATT_CLIENT=y

# Maximum number of connections
CONFIG_BT_MAX_CONN=3
CONFIG_BT_CTLR_SDC_PERIPHERAL_COUNT=3

# Increase stack size for the main thread, system workqueue and BT RX thread
CONFIG_MAIN_STACK_SIZE=2048
CONFIG_SYSTEM_WORKQUEUE_STACK_SIZE=2048
CONFIG_BT_RX_STACK_SIZE=2048
```

## src/main.c
```c
/*
 * MIT License 2025
 * Author: Agustín Coitinho
 * Jelly BLE is a project developed within the course
 * "Tecnologías para la Internet de las Cosas"
 * Facultad de Ingeniería - Universidad de la República, Uruguay
 */
#include "ble_common.h"
#include "ble_callbacks.h"
#include "button.h"
#include "led.h"
#include "jelly_rtt_service.h"
#include "power_debug.h"
#include <zephyr/logging/log.h>

LOG_MODULE_REGISTER(jelly_coordinator_main, LOG_LEVEL_INF);

static void button_changed(uint32_t button_state, uint32_t has_changed)
{
	bool user_button_changed = (has_changed & USER_BUTTON) ? true : false;
	bool user_button_pressed = (button_state & USER_BUTTON) ? true : false;
	if (user_button_changed) {
		LOG_INF("Button %s", (user_button_pressed ? "pressed" : "released"));
	}
}

/* RTT callback */
static void coordinator_rx_cb(struct bt_conn *conn, const jrs_pkt_t *pkt)
{
    /* MEASUREMENT: Forward a message (echo) */
    power_debug_start(DBG_FORWARD);

    int err = bt_jrs_send(conn, pkt);
    if (err) {
        LOG_ERR("Coordinator failed to echo: counter=%d, err=%d", pkt->counter, err);
    } else {
        LOG_INF("Coordinator echoed: counter=%d to conn %p", pkt->counter, (void *)conn);
    }

    power_debug_end(DBG_FORWARD);
}

int main(void)
{
	LOG_INF("Starting Jelly BLE Coordinator");

	if (led_init()) {
        LOG_ERR("Failed to initiate the LED module.");
        return -1;
    }

    if (init_button(button_changed)) {
        LOG_ERR("Failed to initiate the BUTTON module.");
        return -1;
    }

    /* Initialize debug module for current measurements */
    if (power_debug_init()) {
        LOG_ERR("Failed to initiate Power Debug module.");
        return -1;
    }

    register_connection_callbacks();

    ble_init();
	bt_jrs_init(coordinator_rx_cb);

    ble_advertising_init();

    /* MEASUREMENT: Start advertising (first time) */
    power_debug_start(DBG_ADVERTISING);
    ble_advertising_start();

	/* MEASUREMENT: Idle/steady state - The blink loop represents coordinator idle state */
	led_blink_loop(1000);

    return 0;
}
```

## include/ble_callbacks.h
```c
/*
 * MIT License 2025
 * Author: Agustín Coitinho
 * Jelly BLE is a project developed within the course
 * "Tecnologías para la Internet de las Cosas"
 * Facultad de Ingeniería - Universidad de la República, Uruguay
 */
#pragma once

void register_connection_callbacks(void);
```

## src/ble_callbacks.c
```c
/*
 * MIT License 2025
 * Author: Agustín Coitinho
 * Jelly BLE is a project developed within the course
 * "Tecnologías para la Internet de las Cosas"
 * Facultad de Ingeniería - Universidad de la República, Uruguay
 */
#include <zephyr/bluetooth/conn.h>
#include <zephyr/logging/log.h>
#include <dk_buttons_and_leds.h>
#include "led.h"
#include "ble_common.h"
#include "ble_callbacks.h"
#include "power_debug.h"

LOG_MODULE_REGISTER(ble_callbacks, LOG_LEVEL_INF);

static uint8_t active_connections = 0; // Counter for active connections
#define MAX_CONN CONFIG_BT_MAX_CONN

static struct bt_conn *conns[MAX_CONN] = { 0 };

static void restart_advertising_if_needed(void) {
    if (active_connections < MAX_CONN) {
        LOG_INF("Advertising again (active: %d, max: %d)", active_connections, MAX_CONN);
        ble_advertising_start();
    } else {
        LOG_INF("Maximum connections reached: %d", MAX_CONN);
    }
}

static void on_connected(struct bt_conn *conn, uint8_t err) {
    if (err) {
		LOG_ERR("Connection error %d", err);
		return;
	}

    /* MEASUREMENT: Connecting N - Pulse when connection completes */
    power_debug_pulse(0);  /* Pulse on P1.00 to mark connection event */

	if (active_connections < MAX_CONN) {
        conns[active_connections++] = bt_conn_ref(conn);  // save reference
        LOG_INF("Connected");
	    dk_set_led(active_connections, 1);

        /* MEASUREMENT: Idle/steady state with N connections - Set P1.01 based on connection count */
        /* Bit pattern on P1.01 indicates number of active connections */
        power_debug_set(1);  /* P1.01 HIGH = connected state */
    } else {
        LOG_WRN("Too many connections already established!");
    }

	/* STEP 1.1 - Declare a structure to store the connection parameters */
	struct bt_conn_info info;
	err = bt_conn_get_info(conn, &info);
	if (err) {
		LOG_ERR("bt_conn_get_info() returned %d", err);
		return;
	}
	/* STEP 1.2 - Add the connection parameters to your log */
	double connection_interval = info.le.interval*1.25; // in ms
	uint16_t supervision_timeout = info.le.timeout*10; // in ms
	LOG_INF("Connection parameters: interval %.2f ms, latency %d intervals, timeout %d ms", connection_interval, info.le.latency, supervision_timeout);

    /* MEASUREMENT: If we reach MAX_CONN, advertising stops (P1.02 LOW) */
    if (active_connections >= MAX_CONN) {
        power_debug_clear(2);  /* P1.02 LOW = no advertising */
    }

    restart_advertising_if_needed();
	//ble_advertising_start();
	/* update_phy(my_conn);
	k_sleep(K_MSEC(1000)); // Delay added to avoid link layer collisions.
	update_data_length(my_conn);
	update_mtu(my_conn); */
}

static void on_disconnected(struct bt_conn *conn, uint8_t reason) {
    LOG_INF("Disconnected. Reason %d", reason);

	// Search and delete the connection
    for (int i = 0; i < MAX_CONN; i++) {
        if (conns[i] == conn) {
            bt_conn_unref(conns[i]);
            conns[i] = NULL;
            dk_set_led(active_connections--, 0);

            /* MEASUREMENT: If no connections, clear P1.01 */
            if (active_connections == 0) {
                power_debug_clear(1);
            }

            /* MEASUREMENT: If we return to advertise after being full, set P1.02 */
            if (active_connections == MAX_CONN - 1) {
                power_debug_set(2);  /* P1.02 HIGH = advertising active */
                restart_advertising_if_needed();
            }
            break;
        }
    }
}

static void on_le_param_updated(struct bt_conn *conn, uint16_t interval,
                                uint16_t latency, uint16_t timeout) {
    double connection_interval = interval*1.25; // in ms
	uint16_t supervision_timeout = timeout*10; // in ms
	LOG_INF("Connection parameters updated: interval %.2f ms, latency %d intervals, timeout %d ms", connection_interval, latency, supervision_timeout);
}

static void on_recycled(void)
{
	//restart_advertising_if_needed();
}

/* static void on_le_phy_updated(struct bt_conn *conn, struct bt_conn_le_phy_info *param) {
    LOG_INF("LE PHY updated");
} */

/* static void on_le_data_len_updated(struct bt_conn *conn,
                                   struct bt_conn_le_data_len_info *info) {
    LOG_INF("Data length updated");
} */

void register_connection_callbacks(void) {
    static struct bt_conn_cb connection_callbacks = {
        .connected = on_connected,
        .disconnected = on_disconnected,
        .recycled = on_recycled,
        .le_param_updated = on_le_param_updated,
        /* .le_phy_updated = on_le_phy_updated,
        .le_data_len_updated = on_le_data_len_updated, */
    };

    int err = bt_conn_cb_register(&connection_callbacks); // REVISAR cambiar a macro
    if (err) {
        LOG_ERR("Connection callback register failed (err %d)", err);
    }
}
```
